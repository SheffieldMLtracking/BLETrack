## MagicPacket/build_1/Kconfig/Kconfig.shield
```kconfig
osource "/home/christophernoroozi/Desktop/Transmitter/boards/shields/*/Kconfig.shield"
osource "/opt/nordic/ncs/v3.2.4/nrf/boards/shields/*/Kconfig.shield"
```

## MagicPacket/build_1/Kconfig/Kconfig.shield.defconfig
```kconfig
osource "/home/christophernoroozi/Desktop/Transmitter/boards/shields/*/Kconfig.defconfig"
osource "/opt/nordic/ncs/v3.2.4/nrf/boards/shields/*/Kconfig.defconfig"
```

## MagicPacket/build_1/Kconfig/Kconfig.sysbuild.modules
```kconfig
menu "nrf (/home/christophernoroozi/ncs/v2.5.0/nrf)"
osource "/home/christophernoroozi/ncs/v2.5.0/nrf/sysbuild/Kconfig.sysbuild"
config ZEPHYR_NRF_MODULE
	bool
	default y
endmenu
```

## Transmitter/build_1/Kconfig/Kconfig.shield
```kconfig
osource "/home/christophernoroozi/Desktop/Transmitter/boards/shields/*/Kconfig.shield"
osource "/home/christophernoroozi/ncs/v2.5.0/nrf/boards/shields/*/Kconfig.shield"
```
